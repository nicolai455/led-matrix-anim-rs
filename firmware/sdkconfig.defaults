## firmware/sdkconfig.defaults
```kconfig
# Common configuration for matrix-firmware
CONFIG_ESP_MAIN_TASK_STACK_SIZE=24576
CONFIG_ESP_SYSTEM_EVENT_TASK_STACK_SIZE=4096
CONFIG_PTHREAD_TASK_STACK_SIZE_DEFAULT=8192
CONFIG_PTHREAD_STACK_MIN=4096
CONFIG_FREERTOS_HZ=1000
CONFIG_LWIP_MAX_SOCKETS=8
CONFIG_VFS_SUPPORT_IO=y
CONFIG_HTTPD_MAX_REQ_HDR_LEN=1024
CONFIG_HTTPD_MAX_URI_LEN=512
CONFIG_PARTITION_TABLE_CUSTOM=y
CONFIG_PARTITION_TABLE_CUSTOM_FILENAME="partitions.csv"
CONFIG_PARTITION_TABLE_FILENAME="partitions.csv"

# Bound static RX pool while retaining six AMPDU receive slots.
CONFIG_ESP_WIFI_STATIC_RX_BUFFER_NUM=6
```

## firmware/sdkconfig.defaults.esp32
```kconfig
CONFIG_IDF_TARGET="esp32"
CONFIG_COMPILER_OPTIMIZATION_SIZE=y
CONFIG_ESP32_DEFAULT_CPU_FREQ_240=y
CONFIG_ESP32_DEFAULT_CPU_FREQ_MHZ=240
CONFIG_ESPTOOLPY_FLASHSIZE_4MB=y
```
